## custom_defconfigs/yoro_defconfig
```kconfig
# Disable Scamsung anti-root protection
CONFIG_UH=n
CONFIG_RKP=n
CONFIG_KDP=n 
CONFIG_SECURITY_DEFEX=n
CONFIG_PROCA=n
CONFIG_FIVE=n

# Disable Werror
CONFIG_WERROR=n

# Add LOCALVERSION
CONFIG_LOCALVERSION="-ZeroX"
CONFIG_LOCALVERSION_AUTO=n

# KernelSU
CONFIG_KSU=y
CONFIG_KSU_KPROBES_HOOK=y
CONFIG_KSU_LSM_SECURITY_HOOKS=y
CONFIG_KSU_ALLOWLIST_WORKAROUND=y

# TCP CONG
CONFIG_TCP_CONG_BBR=y
CONFIG_DEFAULT_TCP_CONG="bbr"

# HZ
CONFIG_HZ_500=y
CONFIG_HZ=500

# SCHED
CONFIG_SCHED_BORE=y

# LLVM
CONFIG_LLVM_POLLY=y

# FileSystem
CONFIG_TMPFS_XATTR=y
```

## custom_defconfigs/zerox-batt_defconfig
```kconfig
# ZeroX Batt variant

# SCHED
# CONFIG_SCHED_BORE is not set

# Add LOCALVERSION
CONFIG_LOCALVERSION="-ZeroX-Batt"
```

## custom_defconfigs/zerox-common_defconfig
```kconfig
# ZeroX common custom config

# Disable Scamsung anti-root protection
# CONFIG_UH is not set
# CONFIG_RKP is not set
# CONFIG_KDP is not set
# CONFIG_SECURITY_DEFEX is not set
# CONFIG_PROCA is not set
# CONFIG_FIVE is not set

# Disable Werror
# CONFIG_WERROR is not set

# LOCALVERSION_AUTO off (version string is set per-variant)
# CONFIG_LOCALVERSION_AUTO is not set

# LLVM
CONFIG_LLVM_POLLY=y

# FileSystem
CONFIG_TMPFS_XATTR=y

# Governor
CONFIG_CPU_FREQ_GOV_USERSPACE=y
CONFIG_CPU_FREQ_GOV_ONDEMAND=y
CONFIG_CPU_FREQ_GOV_CONSERVATIVE=y

# BBG
CONFIG_BBG=y

# MGLRU
CONFIG_LRU_GEN=y
CONFIG_LRU_GEN_ENABLED=y

# TCP
CONFIG_TCP_CONG_ADVANCED=y
# CONFIG_TCP_CONG_BIC is not set
# CONFIG_TCP_CONG_WESTWOOD is not set
# CONFIG_TCP_CONG_HTCP is not set
CONFIG_TCP_CONG_BBR=y
CONFIG_DEFAULT_BBR=y
CONFIG_DEFAULT_TCP_CONG="bbr"

# Power
CONFIG_WQ_POWER_EFFICIENT_DEFAULT=y

# Custom Toolchain
# CONFIG_CFI_CLANG is not set
# CONFIG_CFI_CLANG_SHADOW is not set
# CONFIG_RELR is not set
```

## custom_defconfigs/zerox-perf_defconfig
```kconfig
# ZeroX Perf variant

# SCHED
CONFIG_SCHED_BORE=y

# Add LOCALVERSION
CONFIG_LOCALVERSION="-ZeroX-Perf"
```

## custom_defconfigs/zerox_defconfig
```kconfig
# Disable Scamsung anti-root protection
CONFIG_UH=n
CONFIG_RKP=n
CONFIG_KDP=n 
CONFIG_SECURITY_DEFEX=n
CONFIG_PROCA=n
CONFIG_FIVE=n

# Disable Werror
CONFIG_WERROR=n

# Add LOCALVERSION
CONFIG_LOCALVERSION="-ZeroX"
CONFIG_LOCALVERSION_AUTO=n

# SCHED

# LLVM
CONFIG_LLVM_POLLY=y

# FileSystem
CONFIG_TMPFS_XATTR=y

# Governer
CONFIG_CPU_FREQ_GOV_USERSPACE=y
CONFIG_CPU_FREQ_GOV_ONDEMAND=y
CONFIG_CPU_FREQ_GOV_CONSERVATIVE=y
```
